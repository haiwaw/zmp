## ZMMP_7100_PL2015_2/components/apps/hello_world/Kconfig
```kconfig
###############################################################################
# Please modify this file if you want to configure your own application.
# You can uncommon and/or change the following Kconfig elements.
###############################################################################


if ROOTFS_COMPONENT_APPS_NAME_HELLO_WORLD
	config APPS_HELLO_WORLD
		bool
		default y
		select ROOTFS_PACKAGES_LIBSTDCPLUSPLUS6
	comment "No additional options for HELLO_WORLD"

# 	config APPS_HELLO_WORLD_OPTION0
#	bool "option0"
#	help
#	  Help text
endif
```
